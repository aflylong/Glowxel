// KOF97 sprite 主索引
// Generated by build-firmware-sprites.js
#pragma once

#include <string.h>
#include "kof97_sprite_types.h"
#include "sprites_heads.h"
#include "sprites_stances.h"

namespace KofSprites {

// 角色 key 列表 (跟 website/src/utils/kof97Renderer.js CHAR_KEYS 顺序一致)
inline const char* charKey(uint8_t idx) {
  static const char* const kKeys[] = {
    "kyo",
    "iori",
    "terry",
    "andy",
    "benimaru",
    "mai",
    "ryo",
    "goro",
    "chang",
    "choi",
    "shermie",
    "yashiro",
    "chizuru",
    "orochi"
  };
  if (idx >= 14) return nullptr;
  return kKeys[idx];
}

inline uint8_t charCount() {
  return 14;
}

// 用 idx 0..13 取头像
inline const KofSprite* getHeadByIndex(uint8_t idx) {
  switch (idx) {
    case 0: return &kHead_kyo;
    case 1: return &kHead_iori;
    case 2: return &kHead_terry;
    case 3: return &kHead_andy;
    case 4: return &kHead_benimaru;
    case 5: return &kHead_mai;
    case 6: return &kHead_ryo;
    case 7: return &kHead_goro;
    case 8: return &kHead_chang;
    case 9: return &kHead_choi;
    case 10: return &kHead_shermie;
    case 11: return &kHead_yashiro;
    case 12: return &kHead_chizuru;
    case 13: return &kHead_orochi;
    default: return nullptr;
  }
}

// 用 idx 0..13 取 stance 集合
inline const KofStanceSet* getStanceSetByIndex(uint8_t idx) {
  switch (idx) {
    case 0: return &kStance_kyo;
    case 1: return &kStance_iori;
    case 2: return &kStance_terry;
    case 3: return &kStance_andy;
    case 4: return &kStance_benimaru;
    case 5: return &kStance_mai;
    case 6: return &kStance_ryo;
    case 7: return &kStance_goro;
    case 8: return &kStance_chang;
    case 9: return &kStance_choi;
    case 10: return &kStance_shermie;
    case 11: return &kStance_yashiro;
    case 12: return &kStance_chizuru;
    case 13: return &kStance_orochi;
    default: return nullptr;
  }
}

// 取某角色的某一帧 sprite
inline const KofSprite* getStanceFrame(uint8_t charIdx, uint8_t frameIdx) {
  const KofStanceSet* set = getStanceSetByIndex(charIdx);
  if (set == nullptr) return nullptr;
  KofStanceSet copied;
  memcpy_P(&copied, set, sizeof(KofStanceSet));
  if (frameIdx >= copied.frameCount) return nullptr;
  KofSprite* p = nullptr;
  memcpy_P(&p, &copied.frames[frameIdx], sizeof(KofSprite*));
  return p;
}

}  // namespace KofSprites
